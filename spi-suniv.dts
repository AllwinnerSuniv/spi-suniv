        spi0: spi@1c05000 {
            compatible = "allwinner,suniv-f1c100s-spi";
            reg = <0x01c05000 0x1000>;
            interrupts = <10>;
            clocks = <&ccu CLK_BUS_SPI0>, <&ccu CLK_BUS_SPI0>;
            clock-names = "ahb", "mod";
			dmas = <&dma 0x04>, <&dma 0x04>;
            dma-names = "rx", "tx";
            resets = <&ccu RST_BUS_SPI0>;
            status = "disabled";
            #address-cells = <1>;
            #size-cells = <0>;
        };

        spi1: spi@1c06000 {
            compatible = "allwinner,suniv-f1c100s-spi";
            reg = <0x01c06000 0x1000>;
            interrupts = <11>;
            clocks = <&ccu CLK_BUS_SPI0>, <&ccu CLK_BUS_SPI0>;
            clock-names = "ahb", "mod";
			dmas = <&dma 0x05>, <&dma 0x05>;
            dma-names = "rx", "tx";
            resets = <&ccu RST_BUS_SPI0>;
            status = "disabled";
            #address-cells = <1>;
            #size-cells = <0>;
        };